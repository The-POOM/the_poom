## modules/poom_wifi_ctrl/Kconfig.projbuild
```kconfig
menu "POOM Wi-Fi Controller"

    config POOM_WIFI_CTRL_SCAN_MAX_AP
        int "Maximum number of scanned access points"
        range 1 100
        default 20
        help
            Maximum number of nearby Access Points (APs) stored during
            a Wi-Fi scan operation. Increasing this value increases RAM usage.
    config POOM_WIFI_CTRL_ENABLE_LOG
        bool "Enable POOM WiFi Controller logs"
        default n
        help
            Enable printf debug logs inside poom_wifi_ctrl.


    config POOM_WIFI_CTRL_ENABLE_MDNS
        bool "Enable mDNS (mdns_manager integration)"
        default y
        help
            Enables optional mDNS advertisement via mdns_manager.
            Requires the mdns_manager component to be present.
            
    menu "POOM Manager Access Point (AP)"

        config POOM_WIFI_CTRL_MANAGER_AP_SSID
            string "Manager AP SSID"
            default "POOM"
            help
                SSID (network name) of the POOM management Access Point.

        config POOM_WIFI_CTRL_MANAGER_AP_PASSWORD
            string "Manager AP Password"
            default "POOM1234"
            help
                WPA2-PSK password for the management AP.
                Must be at least 8 characters if authentication is enabled.

        config POOM_WIFI_CTRL_MANAGER_AP_CHANNEL
            int "Manager AP channel"
            range 1 13
            default 3
            help
                Primary Wi-Fi channel used by the management AP.
                Allowed range: 1–13.

        config POOM_WIFI_CTRL_MANAGER_AP_MAX_CONNECTIONS
            int "Maximum number of connected clients"
            range 1 10
            default 1
            help
                Maximum number of stations that can connect simultaneously
                to the management AP.

        config POOM_WIFI_CTRL_MANAGER_AP_AUTH_ENABLE
            bool "Enable WPA2 authentication"
            default y
            help
                If enabled, the management AP will use WPA2-PSK authentication.
                If disabled, the AP will be open (no password required).
                

    endmenu

endmenu
```

## sdkconfig.defaults
```kconfig
# =========================
# System / Power / FreeRTOS
# =========================
CONFIG_PM_ENABLE=y
CONFIG_PM_SLP_IRAM_OPT=y
CONFIG_PM_RTOS_IDLE_OPT=y
CONFIG_FREERTOS_USE_TICKLESS_IDLE=y
CONFIG_FREERTOS_HZ=1000
CONFIG_GPIO_BUTTON_SUPPORT_POWER_SAVE=y
CONFIG_FREERTOS_USE_TRACE_FACILITY=y
CONFIG_FREERTOS_USE_STATS_FORMATTING_FUNCTIONS=y
CONFIG_ESP_MAIN_TASK_STACK_SIZE=7168
CONFIG_ESP_TASK_WDT_CHECK_IDLE_TASK_CPU0=n

# =========================
# Console / Logs
# =========================
CONFIG_ESP_CONSOLE_USB_SERIAL_JTAG=y
CONFIG_ESP_CONSOLE_USB_SERIAL_JTAG_ENABLED=y
CONFIG_BOOTLOADER_LOG_LEVEL_WARN=y
CONFIG_BOOTLOADER_LOG_LEVEL=2
CONFIG_LOG_DEFAULT_LEVEL_NONE=y
CONFIG_LOG_DEFAULT_LEVEL=0
CONFIG_LOG_MAXIMUM_LEVEL=0
#CONFIG_LOG_MASTER_LEVEL=y

# =========================
# Flash / Partitions / FATFS
# =========================
CONFIG_ESPTOOLPY_FLASHSIZE_8MB=y
CONFIG_PARTITION_TABLE_CUSTOM=y
CONFIG_PARTITION_TABLE_CUSTOM_FILENAME="partitions.csv"
CONFIG_PARTITION_TABLE_OFFSET=0x8000
CONFIG_PARTITION_TABLE_MD5=y
CONFIG_FATFS_LFN_HEAP=y
CONFIG_FATFS_MAX_LFN=31

# =========================
# Wireless: Bluetooth
# =========================
CONFIG_BT_ENABLED=y
CONFIG_BT_BLUEDROID_ENABLED=y
CONFIG_BT_BLE_42_FEATURES_SUPPORTED=y

# =========================
# Wireless: OpenThread / IEEE 802.15.4 / Zigbee
# =========================
CONFIG_OPENTHREAD_ENABLED=y
CONFIG_IEEE802154_ENABLED=y
CONFIG_IEEE802154_RECEIVE_DONE_HANDLER=y
CONFIG_ZB_ENABLED=y
CONFIG_ZB_ZCZR=y

# =========================
# Network Interfaces
# =========================
CONFIG_EXAMPLE_USE_INTERNAL_ETHERNET=n
CONFIG_EXAMPLE_USE_SPI_ETHERNET=n

# =========================
# Security (mbedTLS)
# =========================
CONFIG_MBEDTLS_CMAC_C=y
CONFIG_MBEDTLS_SSL_PROTO_DTLS=y
CONFIG_MBEDTLS_KEY_EXCHANGE_ECJPAKE=y
CONFIG_MBEDTLS_ECJPAKE_C=y

# =========================
# UART
# =========================
CONFIG_UART_ISR_IN_IRAM=y
```
