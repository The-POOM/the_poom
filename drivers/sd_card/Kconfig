## drivers/sd_card/Kconfig
```kconfig
menu "SD Card Driver"

    config SD_CARD_ENABLE_LOG
        bool "Enable SD Card driver logs"
        default n
        help
            Enable printf debug logs inside the sd_card driver (mount,
            unmount, format, and file I/O status/error messages).

            Uses printf(), so ESP log levels do not filter these
            messages.

endmenu
```

## modules/poom_wardrive/Kconfig
```kconfig
menu "Wardrive"
    config POOM_WARDRIVE_DIAGNOSTICS
        bool "Verbose Wardrive serial diagnostics"
        default n
        help
            Print radio, worker, memory and transfer diagnostics while Wardrive
            is open. Off for normal builds. Raw GPS serial output remains a
            separate on-device user option. No global heap hook is installed.
endmenu
```
